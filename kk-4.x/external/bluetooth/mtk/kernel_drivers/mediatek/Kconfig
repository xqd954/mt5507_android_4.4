## kk-4.x/external/bluetooth/mtk/kernel_drivers/mediatek/Kconfig
```kconfig
menuconfig MTK_WIRELESS_SOLUTION
	bool "MTK wireless chip configuration"
	help
		"enable/disable and config MTK wireless solution"

if MTK_WIRELESS_SOLUTION
source "drivers/misc/mediatek/mt7662/Kconfig"
endif
```

## kk-4.x/external/bluetooth/mtk/kernel_drivers/mediatek/mt7662/Kconfig
```kconfig
config MTK_MT7662
	bool "MTK chip MT7662 configuration"
	help
		"MTK chip MT7662"
```
